## conf/layer.conf
```bitbake
# SPDX-License-Identifier: MIT
# Copyright (C) 2026 Advanced Micro Devices, Inc.

BBPATH .= ":${LAYERDIR}"

BBFILES += " \
    ${LAYERDIR}/recipes-*/*/*.bb \
    ${LAYERDIR}/recipes-*/*/*.bbappend \
    "

BBFILE_COLLECTIONS += "kria-apps"
BBFILE_PRIORITY_kria-apps = "5"
BBFILE_PATTERN_kria-apps = "^${LAYERDIR}/"
BBFILE_PATTERN_IGNORE_EMPTY_kria-apps = "1"

LAYERDEPENDS_kria-apps = " \
    core \
    openembedded-layer \
    kria \
    "

LAYERSERIES_COMPAT_kria-apps = "scarthgap"
```
